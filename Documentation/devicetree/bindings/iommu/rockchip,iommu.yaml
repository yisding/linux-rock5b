## Documentation/devicetree/bindings/iommu/rockchip,iommu.yaml
```yaml
# SPDX-License-Identifier: GPL-2.0-only
%YAML 1.2
---
$id: http://devicetree.org/schemas/iommu/rockchip,iommu.yaml#
$schema: http://devicetree.org/meta-schemas/core.yaml#

title: Rockchip IOMMU

maintainers:
  - Heiko Stuebner <heiko@sntech.de>

description: |+
  A Rockchip IOMMU translates I/O virtual addresses to physical addresses for
  its master device. Each peripheral is normally bound to one IOMMU provider
  and shares its clocks, power domain and IRQ.

  For information on assigning IOMMU controller to its peripheral devices,
  see generic IOMMU bindings.

properties:
  compatible:
    oneOf:
      - enum:
          - rockchip,iommu
          - rockchip,rk3568-iommu
      - items:
          - enum:
              - rockchip,rk3576-iommu
              - rockchip,rk3588-iommu
          - const: rockchip,rk3568-iommu

  reg:
    items:
      - description: configuration registers for MMU instance 0
      - description: configuration registers for MMU instance 1
    minItems: 1

  interrupts:
    items:
      - description: interruption for MMU instance 0
      - description: interruption for MMU instance 1
    minItems: 1

  interrupt-names:
    minItems: 1
    maxItems: 2

  clocks:
    items:
      - description: Core clock
      - description: Interface clock

  clock-names:
    items:
      - const: aclk
      - const: iface

  "#iommu-cells":
    const: 0

  power-domains:
    maxItems: 1

  rockchip,disable-mmu-reset:
    $ref: /schemas/types.yaml#/definitions/flag
    description: |
      Do not use the mmu reset operation.
      Some mmu instances may produce unexpected results
      when the reset operation is used.

  rockchip,shared-domain-owner:
    $ref: /schemas/types.yaml#/definitions/phandle
    description: |
      IOMMU provider whose singleton group owns the default DMA domain for
      masters associated with this provider. Use this only when multiple
      hardware masters are one isolation unit and require the same IOVA to
      address shared data, such as the cooperating decoder cores in a cluster.
      The referenced root provider must not contain this property.

required:
  - compatible
  - reg
  - interrupts
  - clocks
  - clock-names
  - "#iommu-cells"

additionalProperties: false

examples:
  - |
    #include <dt-bindings/clock/rk3399-cru.h>
    #include <dt-bindings/interrupt-controller/arm-gic.h>

    vopl_mmu: iommu@ff940300 {
      compatible = "rockchip,iommu";
      reg = <0xff940300 0x100>;
      interrupts = <GIC_SPI 16 IRQ_TYPE_LEVEL_HIGH>;
      clocks = <&cru ACLK_VOP1>, <&cru HCLK_VOP1>;
      clock-names = "aclk", "iface";
      #iommu-cells = <0>;
    };
```

## Documentation/devicetree/bindings/media/rockchip,av1-decoder.yaml
```yaml
# SPDX-License-Identifier: (GPL-2.0-only OR BSD-2-Clause)
%YAML 1.2
---
$id: http://devicetree.org/schemas/media/rockchip,av1-decoder.yaml#
$schema: http://devicetree.org/meta-schemas/core.yaml#

title: Rockchip MPP AV1 Decoder

maintainers:
  - Rockchip Linux <linux@rock-chips.com>

description:
  RK3588 AV1 decoder hardware exposed through the Rockchip MPP service
  /dev/mpp_service ABI.

properties:
  compatible:
    const: rockchip,av1-decoder

  reg:
    items:
      - description: VCD register bank
      - description: cache register bank
      - description: AFBC register bank

  reg-names:
    items:
      - const: vcd
      - const: cache
      - const: afbc

  interrupts:
    items:
      - description: VCD interrupt
      - description: cache interrupt
      - description: AFBC interrupt

  interrupt-names:
    items:
      - const: irq_av1d
      - const: irq_cache
      - const: irq_afbc

  clocks:
    items:
      - description: decoder AXI clock
      - description: decoder AHB clock

  clock-names:
    items:
      - const: aclk_vcodec
      - const: hclk_vcodec

  assigned-clocks: true
  assigned-clock-rates: true

  rockchip,normal-rates:
    $ref: /schemas/types.yaml#/definitions/uint32-array
    minItems: 2
    maxItems: 2
    description: Normal operating rates for the AXI and AHB clocks.

  resets:
    items:
      - description: AXI reset
      - description: AHB reset

  reset-names:
    items:
      - const: video_a
      - const: video_h

  iommus:
    maxItems: 1

  power-domains:
    maxItems: 1

  rockchip,srv:
    $ref: /schemas/types.yaml#/definitions/phandle
    description: MPP service node phandle.

  rockchip,taskqueue-node:
    $ref: /schemas/types.yaml#/definitions/uint32
    description: MPP service taskqueue index used by this decoder.

  rockchip,skip-pmu-idle-request:
    type: boolean
    description:
      Skip the BSP-only PMU idle handshake around reset. This is required on
      mainline kernels that do not provide rockchip_pmu_idle_request().

required:
  - compatible
  - reg
  - reg-names
  - interrupts
  - interrupt-names
  - clocks
  - clock-names
  - resets
  - reset-names
  - iommus
  - power-domains
  - rockchip,srv
  - rockchip,taskqueue-node

additionalProperties: false

examples:
  - |
    #include <dt-bindings/clock/rockchip,rk3588-cru.h>
    #include <dt-bindings/interrupt-controller/arm-gic.h>
    #include <dt-bindings/power/rk3588-power.h>
    #include <dt-bindings/reset/rockchip,rk3588-cru.h>

    bus {
      #address-cells = <2>;
      #size-cells = <2>;

      cru: clock-controller {
        #clock-cells = <1>;
        #reset-cells = <1>;
      };

      power: power-controller {
        #power-domain-cells = <1>;
      };

      mpp_srv: mpp-srv {
        compatible = "rockchip,mpp-service";
      };

      av1d_mmu: iommu@fdca0000 {
        reg = <0x0 0xfdca0000 0x0 0x600>;
        #iommu-cells = <0>;
      };

      video-codec@fdc70000 {
        compatible = "rockchip,av1-decoder";
        reg = <0x0 0xfdc70000 0x0 0x800>,
              <0x0 0xfdc80000 0x0 0x400>,
              <0x0 0xfdc90000 0x0 0x400>;
        reg-names = "vcd", "cache", "afbc";
        interrupts = <GIC_SPI 108 IRQ_TYPE_LEVEL_HIGH 0>,
                     <GIC_SPI 107 IRQ_TYPE_LEVEL_HIGH 0>,
                     <GIC_SPI 106 IRQ_TYPE_LEVEL_HIGH 0>;
        interrupt-names = "irq_av1d", "irq_cache", "irq_afbc";
        clocks = <&cru ACLK_AV1>, <&cru PCLK_AV1>;
        clock-names = "aclk_vcodec", "hclk_vcodec";
        resets = <&cru SRST_A_AV1>, <&cru SRST_P_AV1>;
        reset-names = "video_a", "video_h";
        iommus = <&av1d_mmu>;
        power-domains = <&power RK3588_PD_AV1>;
        rockchip,srv = <&mpp_srv>;
        rockchip,taskqueue-node = <11>;
        rockchip,skip-pmu-idle-request;
      };
    };
```

## Documentation/devicetree/bindings/media/rockchip,iep2.yaml
```yaml
# SPDX-License-Identifier: (GPL-2.0-only OR BSD-2-Clause)
%YAML 1.2
---
$id: http://devicetree.org/schemas/media/rockchip,iep2.yaml#
$schema: http://devicetree.org/meta-schemas/core.yaml#

title: Rockchip RK3588 IEP2 image enhancement processor

maintainers:
  - RKMPP forward-port maintainers <rkmpp-forward-port@example.invalid>

description:
  The RK3588 IEP2 is a fixed-function image enhancement and deinterlacing
  engine exposed to Rockchip userspace as client 28 of /dev/mpp_service.

properties:
  compatible:
    const: rockchip,iep-v2

  reg:
    maxItems: 1

  interrupts:
    maxItems: 1

  interrupt-names:
    const: irq_iep

  clocks:
    minItems: 3
    maxItems: 3

  clock-names:
    items:
      - const: aclk
      - const: hclk
      - const: sclk

  assigned-clocks: true
  assigned-clock-rates: true

  rockchip,normal-rates:
    $ref: /schemas/types.yaml#/definitions/uint32-array
    minItems: 2
    maxItems: 2
    description: Normal operating rates for the AXI and AHB clocks.

  resets:
    minItems: 3
    maxItems: 3

  reset-names:
    items:
      - const: rst_a
      - const: rst_h
      - const: rst_s

  iommus:
    maxItems: 1

  power-domains:
    maxItems: 1

  rockchip,srv:
    $ref: /schemas/types.yaml#/definitions/phandle
    description: Phandle to the vendor MPP service coordinator.

  rockchip,taskqueue-node:
    $ref: /schemas/types.yaml#/definitions/uint32
    description: MPP service taskqueue index used by IEP2.

  rockchip,skip-pmu-idle-request:
    type: boolean

  rockchip,disable-auto-freq:
    type: boolean

required:
  - compatible
  - reg
  - interrupts
  - interrupt-names
  - clocks
  - clock-names
  - resets
  - reset-names
  - iommus
  - power-domains
  - rockchip,srv
  - rockchip,taskqueue-node

additionalProperties: false

examples:
  - |
    #include <dt-bindings/clock/rockchip,rk3588-cru.h>
    #include <dt-bindings/interrupt-controller/arm-gic.h>
    #include <dt-bindings/power/rk3588-power.h>
    #include <dt-bindings/reset/rockchip,rk3588-cru.h>

    bus {
      #address-cells = <2>;
      #size-cells = <2>;

      cru: clock-controller {
        #clock-cells = <1>;
        #reset-cells = <1>;
      };

      power: power-controller {
        #power-domain-cells = <1>;
      };

      mpp_srv: mpp-srv {
        compatible = "rockchip,mpp-service";
      };

      iep_mmu: iommu@fdbb0800 {
        reg = <0x0 0xfdbb0800 0x0 0x100>;
        #iommu-cells = <0>;
      };

      iep@fdbb0000 {
        compatible = "rockchip,iep-v2";
        reg = <0x0 0xfdbb0000 0x0 0x500>;
        interrupts = <GIC_SPI 117 IRQ_TYPE_LEVEL_HIGH 0>;
        interrupt-names = "irq_iep";
        clocks = <&cru ACLK_IEP2P0>, <&cru HCLK_IEP2P0>,
                 <&cru CLK_IEP2P0_CORE>;
        clock-names = "aclk", "hclk", "sclk";
        resets = <&cru SRST_A_IEP2P0>, <&cru SRST_H_IEP2P0>,
                 <&cru SRST_IEP2P0_CORE>;
        reset-names = "rst_a", "rst_h", "rst_s";
        iommus = <&iep_mmu>;
        power-domains = <&power RK3588_PD_VDPU>;
        rockchip,srv = <&mpp_srv>;
        rockchip,taskqueue-node = <6>;
      };
    };
...
```

## Documentation/devicetree/bindings/media/rockchip,mpp-service.yaml
```yaml
# SPDX-License-Identifier: (GPL-2.0-only OR BSD-2-Clause)
%YAML 1.2
---
$id: http://devicetree.org/schemas/media/rockchip,mpp-service.yaml#
$schema: http://devicetree.org/meta-schemas/core.yaml#

title: Rockchip vendor MPP service coordinator

maintainers:
  - RKMPP forward-port maintainers <rkmpp-forward-port@example.invalid>

description:
  The vendor MPP service node is a virtual coordinator used by Rockchip's
  /dev/mpp_service encoder and decoder drivers. It has no register window and
  owns shared taskqueue/resetgroup numbering for child codec cores.

properties:
  compatible:
    const: rockchip,mpp-service

  rockchip,taskqueue-count:
    $ref: /schemas/types.yaml#/definitions/uint32
    description:
      Number of MPP task queues owned by the service coordinator.

  rockchip,resetgroup-count:
    $ref: /schemas/types.yaml#/definitions/uint32
    description:
      Number of shared reset groups owned by the service coordinator.

required:
  - compatible

additionalProperties: true

examples:
  - |
    mpp-srv {
        compatible = "rockchip,mpp-service";
        rockchip,taskqueue-count = <12>;
        rockchip,resetgroup-count = <1>;
    };
...
```

## Documentation/devicetree/bindings/media/rockchip,rga-vendor.yaml
```yaml
# SPDX-License-Identifier: (GPL-2.0-only OR BSD-2-Clause)
%YAML 1.2
---
$id: http://devicetree.org/schemas/media/rockchip,rga-vendor.yaml#
$schema: http://devicetree.org/meta-schemas/core.yaml#

title: Rockchip vendor RGA2/RGA3 nodes

maintainers:
  - RKMPP forward-port maintainers <rkmpp-forward-port@example.invalid>

description:
  Vendor RGA nodes used by Rockchip's librga-compatible driver. RK3588 exposes
  two RGA3 cores and one RGA2 core as separate platform devices.

properties:
  compatible:
    enum:
      - rockchip,rga2_core0
      - rockchip,rga3_core0
      - rockchip,rga3_core1

  reg: true
  interrupts: true
  interrupt-names: true
  clocks: true
  clock-names: true
  iommus: true
  power-domains: true

required:
  - compatible
  - reg

additionalProperties: true

examples:
  - |
    rga@fdb60000 {
        compatible = "rockchip,rga3_core0";
        reg = <0x0 0xfdb60000 0x0 0x1000>;
        interrupts = <114>;
        interrupt-names = "rga3_core0_irq";
    };
...
```

## Documentation/devicetree/bindings/media/rockchip,rkvdec2.yaml
```yaml
# SPDX-License-Identifier: (GPL-2.0-only OR BSD-2-Clause)
%YAML 1.2
---
$id: http://devicetree.org/schemas/media/rockchip,rkvdec2.yaml#
$schema: http://devicetree.org/meta-schemas/core.yaml#

title: Rockchip vendor RKVDEC2 decoder nodes

maintainers:
  - RKMPP forward-port maintainers <rkmpp-forward-port@example.invalid>

description:
  Vendor MPP VDPU381/RKVDEC2 decoder binding used by Rockchip userspace through
  /dev/mpp_service. The CCU node coordinates the two decoder cores; board files
  may convert base video-codec nodes to the vendor-compatible core binding.

properties:
  compatible:
    enum:
      - rockchip,rkv-decoder-v2
      - rockchip,rkv-decoder-v2-ccu

  reg: true
  reg-names: true
  interrupts: true
  interrupt-names: true
  clocks: true
  clock-names: true
  assigned-clocks: true
  assigned-clock-rates: true
  resets: true
  reset-names: true
  iommus: true
  power-domains: true

  rockchip,srv:
    $ref: /schemas/types.yaml#/definitions/phandle
    description:
      Phandle to the vendor MPP service coordinator node.

  rockchip,ccu:
    $ref: /schemas/types.yaml#/definitions/phandle
    description:
      Phandle to the decoder CCU node used by dual-core decoder instances.

  rockchip,sram:
    $ref: /schemas/types.yaml#/definitions/phandle
    description:
      Phandle to the SRAM pool used for decoder row-column buffers.

  rockchip,core-mask:
    $ref: /schemas/types.yaml#/definitions/uint32
    description:
      Bitmask identifying the decoder core in the vendor CCU register layout.

  rockchip,taskqueue-node:
    $ref: /schemas/types.yaml#/definitions/uint32
    description:
      MPP service task-queue index used by this decoder node.

  rockchip,task-capacity:
    $ref: /schemas/types.yaml#/definitions/uint32
    description:
      Maximum number of queued MPP tasks for this decoder node.

  rockchip,rcb-iova:
    $ref: /schemas/types.yaml#/definitions/uint32-array
    minItems: 2
    maxItems: 2
    description:
      IOVA base and size reserved for decoder row-column buffers.
  rockchip,rcb-info:
    $ref: /schemas/types.yaml#/definitions/uint32-matrix
    items:
      minItems: 2
      maxItems: 2
    description:
      Decoder row-column buffer register and size pairs.
  rockchip,rcb-min-width:
    $ref: /schemas/types.yaml#/definitions/uint32
    description:
      Minimum frame width at which the row-column buffer path is enabled.
  rockchip,ccu-mode:
    $ref: /schemas/types.yaml#/definitions/uint32
    description:
      Vendor CCU scheduling mode selected by the decoder driver.
  rockchip,normal-rates:
    $ref: /schemas/types.yaml#/definitions/uint32-array
    description:
      Normal operating clock rates programmed by the vendor MPP driver.
  rockchip,skip-pmu-idle-request:
    $ref: /schemas/types.yaml#/definitions/flag
    description:
      Present when the driver must skip Rockchip PMU idle request calls.

required:
  - compatible

additionalProperties: true

examples:
  - |
    rkvdec-ccu@fdc30000 {
        compatible = "rockchip,rkv-decoder-v2-ccu";
        reg = <0x0 0xfdc30000 0x0 0x100>;
        reg-names = "ccu";
        rockchip,ccu-mode = <1>;
    };

    video-codec@fdc38100 {
        compatible = "rockchip,rkv-decoder-v2";
        reg = <0x0 0xfdc38100 0x0 0x400>, <0x0 0xfdc38000 0x0 0x100>;
        reg-names = "regs", "link";
        rockchip,core-mask = <0x00010001>;
    };
...
```
