## Documentation/devicetree/bindings/media/rockchip,rkvenc2.yaml
```yaml
# SPDX-License-Identifier: (GPL-2.0-only OR BSD-2-Clause)
%YAML 1.2
---
$id: http://devicetree.org/schemas/media/rockchip,rkvenc2.yaml#
$schema: http://devicetree.org/meta-schemas/core.yaml#

title: Rockchip vendor RKVENC2 encoder nodes

maintainers:
  - RKMPP forward-port maintainers <rkmpp-forward-port@example.invalid>

description:
  Vendor MPP VEPU580/RKVENC2 encoder binding used by Rockchip userspace through
  /dev/mpp_service. The CCU node is virtual and the core nodes describe the
  MMIO encoder instances behind Rockchip IOMMUs.

properties:
  compatible:
    enum:
      - rockchip,rkv-encoder-v2-ccu
      - rockchip,rkv-encoder-v2-core

  reg: true
  reg-names: true
  interrupts: true
  interrupt-names: true
  clocks: true
  clock-names: true
  assigned-clocks: true
  assigned-clock-rates: true
  resets: true
  reset-names: true
  iommus: true
  power-domains: true

  rockchip,srv:
    $ref: /schemas/types.yaml#/definitions/phandle
    description:
      Phandle to the vendor MPP service coordinator node.

  rockchip,ccu:
    $ref: /schemas/types.yaml#/definitions/phandle
    description:
      Phandle to the encoder CCU node used by dual-core encoder instances.

  rockchip,taskqueue-node:
    $ref: /schemas/types.yaml#/definitions/uint32
    description:
      MPP service task-queue index used by this encoder node.

  rockchip,task-capacity:
    $ref: /schemas/types.yaml#/definitions/uint32
    description:
      Maximum number of queued MPP tasks for this encoder node.

  rockchip,normal-rates:
    $ref: /schemas/types.yaml#/definitions/uint32-array
    description:
      Normal operating clock rates programmed by the vendor MPP driver.
  rockchip,skip-pmu-idle-request:
    $ref: /schemas/types.yaml#/definitions/flag
    description:
      Present when the driver must skip Rockchip PMU idle request calls.

required:
  - compatible

additionalProperties: true

examples:
  - |
    rkvenc-ccu {
        compatible = "rockchip,rkv-encoder-v2-ccu";
    };

    rkvenc-core@fdbd0000 {
        compatible = "rockchip,rkv-encoder-v2-core";
        reg = <0x0 0xfdbd0000 0x0 0x6000>;
        interrupts = <101>;
        interrupt-names = "irq_rkvenc0";
        rockchip,taskqueue-node = <7>;
        rockchip,task-capacity = <8>;
    };
...
```

## drivers/input/joystick/spi-mcu-joypad/Kconfig
```kconfig
# SPDX-License-Identifier: GPL-2.0-only

config JOYSTICK_SPI_MCU_JOYPAD
	tristate "SPI MCU Joypad (Anbernic analog sticks + RGB LEDs)"
	depends on SPI
	depends on LEDS_CLASS_MULTICOLOR
	help
	  Say Y here if you have an Anbernic handheld with analog sticks
	  and RGB LEDs controlled by an MCU over SPI.

	  The driver exposes six analog axes via the input subsystem and
	  two RGB LED rings (one per stick) via the multicolor LED class.

	  To compile this driver as a module, choose M here: the
	  module will be called spi-mcu-joypad.
```

## drivers/video/rockchip/Kconfig
```kconfig
# SPDX-License-Identifier: GPL-2.0
source "drivers/video/rockchip/mpp/Kconfig"
source "drivers/video/rockchip/rga3/Kconfig"
source "drivers/video/rockchip/mpp-rewrite/Kconfig"
source "drivers/video/rockchip/rga-rewrite/Kconfig"
```

## drivers/video/rockchip/mpp-rewrite/Kconfig
```kconfig
# SPDX-License-Identifier: GPL-2.0
config ROCKCHIP_MPP_REWRITE
	tristate "Rockchip MPP service compatibility rewrite"
	depends on ARCH_ROCKCHIP
	depends on !ROCKCHIP_MPP_SERVICE
	select DMA_SHARED_BUFFER
	help
	  Minimal ABI-compatible /dev/mpp_service rewrite for RK3588 bring-up.
	  This driver preserves the userspace ioctl parser, query commands,
	  session switching, and dma-buf fd-to-IOVA import/release using public
	  APIs. It includes the RK3588 RKVENC2/VDPU381 register execution
	  paths used by current upstream MPP consumers while leaving unsupported
	  BSP-only commands as explicit errors.

config ROCKCHIP_MPP_REWRITE_KUNIT_TEST
	bool "KUnit tests for Rockchip MPP service compatibility rewrite" if !KUNIT_ALL_TESTS
	depends on ROCKCHIP_MPP_REWRITE=y && KUNIT
	default KUNIT_ALL_TESTS
	help
	  Unit tests for rewrite-local MPP ABI parser helpers, including
	  command range classification and register-span validation.
	  The in-source suite uses the service singleton as test-fixture
	  storage, so it is available only when the driver is built in and
	  can bind after the suite has completed.
```

## drivers/video/rockchip/mpp/Kconfig
```kconfig
# SPDX-License-Identifier: GPL-2.0
config ROCKCHIP_MPP_SERVICE
	tristate "Rockchip MPP service framework"
	depends on ARCH_ROCKCHIP && ROCKCHIP_IOMMU
	default y
	select DMA_SHARED_BUFFER
	help
	  Rockchip Media Process Platform (MPP) service framework. Provides the
	  /dev/mpp_service char device and the shared task/IOMMU/clk/pm core used
	  by the Rockchip hardware codec device drivers.

if ROCKCHIP_MPP_SERVICE

config ROCKCHIP_MPP_PROC_FS
	bool "Rockchip MPP procfs"
	depends on PROC_FS
	default y
	help
	  Expose per-device runtime state under /proc/mpp_service.

config ROCKCHIP_MPP_RKVENC2
	bool "RKVENC2 (VEPU580) H.264/H.265 encoder"
	default y
	help
	  Hardware video encoder VEPU580 (rkvenc2) found on RK3588. H.264 and
	  H.265 encode.

config ROCKCHIP_MPP_RKVENC2_DEVFREQ
	bool "RKVENC2 devfreq/OPP/thermal (tier-2)"
	depends on ROCKCHIP_MPP_RKVENC2 && PM_DEVFREQ
	default n
	help
	  Enable the devfreq/OPP/system-monitor DVFS island for rkvenc2. Off by
	  default; the encoder runs at fixed assigned-clock-rates without it.

config ROCKCHIP_MPP_RKVDEC2
	bool "RKVDEC2 (VDPU381) H.264/H.265/VP9 decoder"
	default y
	help
	  Hardware video decoder VDPU381 (rkvdec2) found on RK3588: two decoder
	  cores plus a CCU. H.264, H.265 and VP9 decode. Builds the
	  mpp_rkvdec2 + mpp_rkvdec2_link objects into rk_vcodec.ko.

config ROCKCHIP_MPP_RKVDEC2_DEVFREQ
	bool "RKVDEC2 devfreq/OPP/system-monitor (tier-2)"
	depends on ROCKCHIP_MPP_RKVDEC2 && PM_DEVFREQ
	default n
	help
	  Enable the devfreq/OPP/system-monitor DVFS island for rkvdec2. Off by
	  default; the decoder runs at fixed assigned-clock-rates without it.
	  When off, the donor's private ../drivers/devfreq/governor.h include is
	  elided (it is absent from out-of-tree build trees).

config ROCKCHIP_MPP_IEP2
	bool "IEP2 image enhancement and deinterlacing"
	depends on ARM64
	default y
	help
	  Hardware IEP2 image enhancement and deinterlacing block found on
	  RK3588. The driver registers MPP client type 28 through the shared
	  /dev/mpp_service interface used by Rockchip libmpp.

config ROCKCHIP_MPP_AV1DEC
	bool "AV1 decoder"
	depends on ARM64 && IOMMU_SUPPORT
	default y
	select VSI_IOMMU
	help
	  Hardware AV1 decoder backend for the Rockchip MPP service framework
	  on RK3588. This preserves the vendor /dev/mpp_service ABI and uses
	  the standard Verisilicon IOMMU provider for the AV1 MMU.

endif
```

## drivers/video/rockchip/rga-rewrite/Kconfig
```kconfig
# SPDX-License-Identifier: GPL-2.0
config ROCKCHIP_RGA_REWRITE
	tristate "Rockchip RGA compatibility rewrite"
	depends on ARCH_ROCKCHIP
	depends on !ROCKCHIP_MULTI_RGA
	depends on !VIDEO_ROCKCHIP_RGA
	select DMA_SHARED_BUFFER
	help
	  ABI-compatible /dev/rga rewrite for RK3588 bring-up. This driver
	  preserves version/query, import/release, request lifetime, legacy
	  ioctl recognition, and the focused RGA2/RGA3 execution profiles used
	  by current userspace.

config ROCKCHIP_RGA_REWRITE_KUNIT_TEST
	bool "KUnit tests for Rockchip RGA compatibility rewrite" if !KUNIT_ALL_TESTS
	depends on ROCKCHIP_RGA_REWRITE=y && KUNIT
	default KUNIT_ALL_TESTS
	help
	  Unit tests for rewrite-local ABI normalization helpers, including
	  RGA2 userspace transform decoding and destination-corner selection.
	  The in-source suite temporarily unbinds the built-in driver during
	  boot, uses the service singleton as test-fixture storage, and restores
	  the production driver before initramfs. Post-boot reruns are rejected
	  so they cannot disturb live sessions.
```
